## firmware/esp32s3/main/Kconfig.projbuild
```kconfig
menu "Linx Intercom"

config INTERCOM_DEVICE_TOKEN
    string "Backend device bearer token"
    default ""
    help
        Per-device token registered in the Go backend. Keep sdkconfig local and never commit it.

config INTERCOM_BACKEND_URI
    string "Go backend WebSocket URI"
    default "wss://intercom.example.com/device/ws"

config INTERCOM_SERIAL_NUMBER
    string "Optional pre-registered device serial number"
    default ""
    help
        Leave empty for activation version 1. Set a valid pre-registered serial number to use activation version 2.

config INTERCOM_I2S_BCLK_GPIO
    int "I2S bit clock GPIO"
    range 0 48
    default 5

config INTERCOM_I2S_WS_GPIO
    int "I2S word select GPIO"
    range 0 48
    default 6

config INTERCOM_I2S_DOUT_GPIO
    int "I2S codec DAC data GPIO"
    range 0 48
    default 7

config INTERCOM_I2S_DIN_GPIO
    int "I2S codec ADC data GPIO"
    range 0 48
    default 4

config INTERCOM_I2S_MCLK_GPIO
    int "I2S master clock GPIO (-1 when unused)"
    range -1 48
    default -1

config INTERCOM_AUDIO_AMPLIFIER_GPIO
    int "Audio amplifier enable GPIO (-1 when unused)"
    range -1 48
    default -1

config INTERCOM_AUDIO_AMPLIFIER_ACTIVE_LEVEL
    int "Audio amplifier enable active level"
    range 0 1
    default 1

config INTERCOM_RESET_BUTTON_GPIO
    int "Hold-to-reset Wi-Fi provisioning button GPIO (-1 disables it)"
    range -1 48
    default -1

endmenu
```

## firmware/esp32s3/sdkconfig.defaults
```kconfig
CONFIG_BT_ENABLED=y
CONFIG_BT_BLUEDROID_ENABLED=y
CONFIG_BT_NIMBLE_ENABLED=n
CONFIG_BT_GATTS_ENABLE=y
CONFIG_BT_BLE_BLUFI_ENABLE=y
CONFIG_BT_BLE_42_FEATURES_SUPPORTED=y
CONFIG_PARTITION_TABLE_CUSTOM=y
CONFIG_PARTITION_TABLE_CUSTOM_FILENAME="partitions.csv"
CONFIG_ESPTOOLPY_FLASHSIZE_16MB=y
CONFIG_SPIRAM=y
CONFIG_SPIRAM_MODE_OCT=y
CONFIG_SPIRAM_SPEED_80M=y
CONFIG_MBEDTLS_CERTIFICATE_BUNDLE=y
CONFIG_MBEDTLS_CERTIFICATE_BUNDLE_DEFAULT_FULL=y
CONFIG_MBEDTLS_DHM_C=y
CONFIG_MBEDTLS_AES_C=y
```
